#include <Adafruit_BMP280.h>
#include <Adafruit_GFX.h>
#include <Adafruit_ST7735.h>
#include <Adafruit_Sensor.h>
#include <Fonts/FreeSans12pt7b.h>
#include <Fonts/FreeSans18pt7b.h>
#include <Fonts/FreeSans24pt7b.h>
#include <Fonts/FreeSans9pt7b.h>
#include <Fonts/FreeSansBold12pt7b.h>
#include <Fonts/FreeSansBold18pt7b.h>
#include <Fonts/FreeSansBold24pt7b.h>
#include <Fonts/FreeSansBold9pt7b.h>
#include <HTTPClient.h>
#include <SPI.h>
#include <SoftwareSerial.h>
#include <TinyGPS++.h>
#include <Wire.h>
#include "WiFi.h"
#define TFT_CS 15
#define TFT_RST 4
#define TFT_DC 5
#define TFT_SCLK 18
#define TFT_MOSI 23
#define BMP_SDA 21
#define BMP_SCL 22
#define GPS_TX 17	// ESP32 TX pin connected to GPS module RX pin
#define GPS_RX 16	// ESP32 RX pin connected to GPS module TX pin
#define LCD_SDA 23
#define LCD_SCL 19
#define RGB(r, g, b)(((r & 0xF8) << 8) | ((g & 0xFC) << 3) | (b >> 3))
#define DARKGREY RGB(50, 50, 50)
#define LIGHTGREY RGB(93, 93, 93)
#define BUTTON_PIN 12
int buttonState = HIGH;
int lastButtonState = HIGH;
int currentScreen = 0;
int radius = 15;
int thickness = 7;
int delayTime = 50;
const char *ssid = "SSID"; //Change this
const char *password = "PASSWORD"; //Change this
const char *serverName = "HTTPS"; // Change this
float setPressure = 1035.76;
Adafruit_BMP280 bmp;
TinyGPSPlus gps;
Adafruit_ST7735 tft = Adafruit_ST7735(TFT_CS, TFT_DC, TFT_MOSI, TFT_SCLK, TFT_RST);
SoftwareSerial gpsSerial(GPS_RX, GPS_TX);
String strTemp, strPressure;
String strLon = "not available";
String strLat = "not available";
String strAlt = "not available";
String numSats = "0";
String hour = "not available";
String minute = "not available";
String speed = "not available";
const uint16_t WIDTH = 160;
const uint16_t HEIGHT = 128;
const unsigned char GPSBoot[] PROGMEM = { 0x00, 0x00, 0x00, 0x00, 0x00, 0x00, 0x00, 0x00, 0x00, 0x00, 0x00, 0x00, 0x00,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 0x00
};

const unsigned char logoo[] PROGMEM = { 0x00, 0x00, 0x00, 0x00, 0x00, 0x00, 0x00, 0x00, 0x00, 0x00, 0x00, 0x00, 0x00,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 0x00
};

const unsigned char wifilogo[] PROGMEM = { 0x00, 0x00, 0x00, 0x00, 0x00, 0x00, 0x00, 0x00, 0x00, 0x00, 0x00, 0x00, 0x00,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 0x00
};

void setup()
{
	bmp.setSampling(Adafruit_BMP280::MODE_NORMAL, Adafruit_BMP280::SAMPLING_X1, Adafruit_BMP280::SAMPLING_X1, Adafruit_BMP280::FILTER_X16, Adafruit_BMP280::STANDBY_MS_500);
	pinMode(BUTTON_PIN, INPUT_PULLUP);
	Serial.begin(9600);
	gpsSerial.begin(9600);
	Wire.begin(BMP_SDA, BMP_SCL);
	bmp.begin(0x76);
	tft.initR(INITR_BLACKTAB);
	tft.setRotation(0);
	tft.fillScreen(ST7735_BLACK);
	tft.drawBitmap(3, 30, logoo, 120, 64, ST7735_WHITE);
	tft.setCursor(13.5, 95);
	tft.setTextSize(1);
	tft.setTextColor(ST7735_WHITE);
	tft.print("By: Timo Poyhonen");
	for (int i = 0; i < 98; i += 4)
	{
		tft.fillRect(15, 125, i, 4, ST7735_ORANGE);
		delay(55);
	}

	delay(900);
	tft.fillScreen(ST7735_BLACK);
	tft.drawBitmap(32, 25, wifilogo, 64, 64, ST7735_WHITE);
	tft.setCursor(12, 100);
	tft.setTextSize(1);
	tft.setTextColor(ST7735_WHITE);
	tft.print("Waiting for Wi-Fi");
	while (WiFi.status() != WL_CONNECTED)
	{
		initWiFi();
		int centerX = tft.width() / 2;
		int centerY = tft.height() / 2 + tft.height() / 3;
		for (int i = 0; i < 12; i++)
		{
			int x1 = centerX + (radius - thickness) *cos(i *30 *PI / 180);
			int y1 = centerY + (radius - thickness) *sin(i *30 *PI / 180);
			int x2 = centerX + radius* cos(i *30 *PI / 180);
			int y2 = centerY + radius* sin(i *30 *PI / 180);
			tft.drawLine(x1, y1, x2, y2, ST7735_WHITE);
			delay(60);
			tft.drawLine(x1, y1, x2, y2, DARKGREY);
		}
	}

	tft.fillScreen(ST7735_BLACK);
}

void initWiFi()
{
	WiFi.mode(WIFI_STA);
	WiFi.begin(ssid, password);
	Serial.print("Waiting for WiFi");
	Serial.println(WiFi.localIP());
}

void loop()
{
	buttonState = digitalRead(BUTTON_PIN);
	if (buttonState == LOW && lastButtonState == HIGH)
	{
		currentScreen = (currentScreen + 1) % 3;
		tft.fillScreen(ST7735_BLACK);
	}

	while (gpsSerial.available() > 0)
	{
		if (gps.encode(gpsSerial.read()))
		{
			strLat = String(gps.location.lat(), 6);
			strLon = String(gps.location.lng(), 6);
			strAlt = String(gps.altitude.meters(), 2);
			numSats = String(gps.satellites.value());
			hour = String(gps.time.hour());
			minute = String(gps.time.minute());
			speed = String(gps.speed.kmph(), 1);
			strTemp = bmp.readTemperature(), 1;
			strPressure = bmp.readPressure() / 100;
			UpdateWeb();
			if (gps.location.isValid() == 1)
			{
				tft.fillScreen(ST7735_BLACK);
				if (currentScreen == 0)
				{
					screenOne();
				}
				else if (currentScreen == 1)
				{
					screenTwo();
				}
				else if (currentScreen == 2)
				{
					screenThree();
				}

				lastButtonState = buttonState;
			}
			else
			{
				screenGPS();
			}
		}
	}
}

void UpdateWeb()
{
	if (WiFi.status() == WL_CONNECTED)
	{
		WiFiClient client;
		HTTPClient http;
		http.begin(serverName);
		http.addHeader("Content-Type", "text/plain");
		String httpRequestData = strLat + "," + strLon + "," + strTemp + "," + strPressure + "," + strAlt + "," + numSats;
		int httpResponseCode = http.POST(httpRequestData);
		Serial.println(httpRequestData);
		http.end();
	}
	else
	{
		Serial.println("WiFi Disconnected");
	}
}

void screenOne()
{
	tft.setFont(&FreeSansBold24pt7b);
	tft.setCursor(10, 45);
	tft.setTextColor(ST7735_ORANGE);
	tft.setTextSize(1);
	tft.print("LAT:");
	tft.setFont(&FreeSans12pt7b);
	tft.setCursor(10, 70);
	tft.setTextColor(ST7735_WHITE);
	tft.setTextSize(1);
	tft.print(strLat);
	tft.setFont(&FreeSansBold24pt7b);
	tft.setCursor(10, 120);
	tft.setTextColor(ST7735_ORANGE);
	tft.setTextSize(1);
	tft.print("LNG:");
	tft.setFont(&FreeSans12pt7b);
	tft.setCursor(10, 145);
	tft.setTextColor(ST7735_WHITE);
	tft.setTextSize(1);
	tft.print(strLon);
}

void screenTwo()
{
	tft.setFont();
	tft.setCursor(10, 10);
	tft.setTextColor(ST7735_MAGENTA);
	tft.setTextSize(1);
	tft.print("Sat: ");
	tft.setTextColor(ST7735_WHITE);
	tft.print(numSats);
	tft.setCursor(10, 25);
	tft.setTextColor(ST7735_MAGENTA);
	tft.setTextSize(1);
	tft.print("Lat: ");
	tft.setTextColor(ST7735_WHITE);
	tft.print(strLat);
	tft.setCursor(10, 40);
	tft.setTextColor(ST7735_MAGENTA);
	tft.setTextSize(1);
	tft.print("Lng: ");
	tft.setTextColor(ST7735_WHITE);
	tft.print(strLon);
	tft.setCursor(10, 55);
	tft.setTextColor(ST7735_MAGENTA);
	tft.setTextSize(1);
	tft.print("Temp: ");
	tft.setTextColor(ST7735_WHITE);
	tft.print(strTemp);
	tft.print("C");
	tft.setCursor(10, 70);
	tft.setTextColor(ST7735_MAGENTA);
	tft.setTextSize(1);
	tft.print("Press: ");
	tft.setTextColor(ST7735_WHITE);
	tft.print(strPressure);
	tft.print("hPa");
	tft.setCursor(10, 85);
	tft.setTextColor(ST7735_MAGENTA);
	tft.setTextSize(1);
	tft.print("Alt: ");
	tft.setTextColor(ST7735_WHITE);
	tft.print(strAlt);
	tft.print("m");
	tft.setCursor(10, 100);
	tft.setTextColor(ST7735_MAGENTA);
	tft.setTextSize(1);
	tft.print("Speed: ");
	tft.setTextColor(ST7735_WHITE);
	tft.print(speed);
	tft.print("km/h");
	tft.setCursor(10, 115);
	tft.setTextColor(ST7735_MAGENTA);
	tft.setTextSize(1);
	tft.print("Time: ");
	tft.setTextColor(ST7735_WHITE);
	tft.print(hour);
	tft.print(":");
	tft.print(minute);
	tft.print(" GMT+0");
}

void screenThree()
{
	tft.setFont();
	tft.setCursor(10, 10);
	tft.setTextColor(ST7735_WHITE);
	tft.setTextSize(1);
	tft.println("Screen 2");
}

void screenGPS()
{
	tft.drawBitmap(6, 5, GPSBoot, 100, 100, ST7735_WHITE);
	tft.fillRect(60, 135, 10, 10, ST7735_BLACK);
	tft.setTextColor(ST7735_WHITE);
	tft.setTextSize(1);
	tft.setCursor(10, 120);
	tft.print("Finding satellites");
	delay(5000);
	tft.fillScreen(ST7735_BLACK);
}
